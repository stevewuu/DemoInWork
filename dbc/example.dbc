VERSION ""
NS_ :

BS_:
BU_: ECU_A ECU_B

BO_ 256 SignalMessage: 8 ECU_A
 SG_ EngineSpeed : 0|16@1+ (0.125,0) [0|8000] "rpm" ECU_A
 SG_ VehicleSpeed : 16|16@1+ (0.01,0) [0|250] "km/h" ECU_A

BO_ 512 StatusMessage: 8 ECU_B
 SG_ StatusFlag : 0|8@1+ (1,0) [0|255] "" ECU_B
